/******************************************************************************

  Copyright (C), 2005-2014, CVTE.

 ******************************************************************************
  File Name     : UartCommandSever.c
  Version       : Initial Draft
  Author        : qiuweibo
  Created       : 2015/4/9
  Last Modified :
  Description   : Uart Command Sever
  Function List :
  History       :
  1.Date        : 2015/4/9
    Author      : qiuweibo
    Modification: Created file

******************************************************************************/
#include "includes.h"
#include "FreeRTOS_CLI.h"
#include "UartCommandSever.h"

/*----------------------------------------------*
 * external variables                           *
 *----------------------------------------------*/
extern long serial_recvCLICommand(signed char *pBuf, signed char nMaxLen);
extern long serial_sendCLIResult(signed char *pBuf, signed char nMaxLen);

/*----------------------------------------------*
 * external routine prototypes                  *
 *----------------------------------------------*/

/*----------------------------------------------*
 * constants                                    *
 *----------------------------------------------*/

/*----------------------------------------------*
 * macros                                       *
 *----------------------------------------------*/
/* Dimensions the buffer into which input characters are placed. */
#define cmdMAX_INPUT_SIZE	64
/* Dimensions the buffer into which string outputs can be placed. */
#define cmdMAX_OUTPUT_SIZE	1024
#define comBUFFER_LEN				( ( UBaseType_t ) 64 )


//#define _UART_CMD_INFO_
#ifdef _UART_CMD_INFO_
#define UART_CMD_INFO(fmt, arg...) udprintf("\r\n[UartCMD] "fmt, ##arg)
#else
#define UART_CMD_INFO(fmt, arg...) do{}while(0)
#endif

/*----------------------------------------------*
 * project-wide global variables                *
 *----------------------------------------------*/

/*----------------------------------------------*
 * internal variables                           *
 *----------------------------------------------*/
 
/*----------------------------------------------*
 * internal routine prototypes                  *
 *----------------------------------------------*/

/*----------------------------------------------*
 * routines' implementations                    *
 *----------------------------------------------*/

/*
 * Task that provides the input and output for the FreeRTOS+CLI command
 * interpreter.  In this case a UDP port is used.  See the URL in the comments
 * within main.c for the location of the online documentation.
 */
void vUartCommandInterpreterTask( void *pvParameters )
{
    long lBytes, lByte;
    signed char cInChar, cInputIndex = 0;
    static signed char cInputString[ cmdMAX_INPUT_SIZE ];
    static signed char cOutputString[ cmdMAX_OUTPUT_SIZE ];
    static signed char cLocalBuffer[ comBUFFER_LEN ];
    BaseType_t xMoreDataToFollow;
    volatile int iErrorCode = 0;

	/* Just to prevent compiler warnings. */
	( void ) pvParameters;

    udprintf("\r\n[UartCMD] vUartCommandInterpreterTask running...");
	for( ;; )
	{
		/* Wait for incoming data on the opened uart */
		lBytes = serial_recvCLICommand( cLocalBuffer, sizeof( cLocalBuffer ));
        UART_CMD_INFO("CommandTasks cmd=%s",cLocalBuffer);
		/* Process each received byte in turn. */
		lByte = 0;
		while( lByte < lBytes )
		{
			/* The next character in the input buffer. */
			cInChar = cLocalBuffer[ lByte ];
			lByte++;

			/* Newline characters are taken as the end of the command string. */
			if( CLI_CMD_END_TAG == cInChar )
			{
				/* Process the input string received prior to the newline. */
				do
				{
					/* Pass the string to FreeRTOS+CLI. */
					xMoreDataToFollow = FreeRTOS_CLIProcessCommand( 
					    cInputString,
					    (char *)cOutputString,
					    cmdMAX_OUTPUT_SIZE );

					/* Send the output generated by the command's implementation. */
					serial_sendCLIResult(cOutputString,  strlen( cOutputString ));

				} while( xMoreDataToFollow != pdFALSE ); /* Until the command does not generate any more output. */

				/* All the strings generated by the command processing
				have been sent.  Clear the input string ready to receive
				the next command. */
				cInputIndex = 0;
				memset( cInputString, 0x00, cmdMAX_INPUT_SIZE );

				/* Transmit a spacer, just to make the command console easier to read. */
				serial_sendCLIResult( "\r\n>>",  strlen( "\r\n>>" ));
			} // end of if( cInChar == '\n' )
			else
			{
				if( cInChar == '\b' )
				{
					/* Backspace was pressed.  Erase the last character
					in the string - if any. */
					if( cInputIndex > 0 )
					{
						cInputIndex--;
						cInputString[ cInputIndex ] = '\0';
					}
				}
				else
				{
					/* A character was entered.  Add it to the string
					entered so far.  When a \n is entered the complete
					string will be passed to the command interpreter. */
					if( cInputIndex < cmdMAX_INPUT_SIZE )
					{
						cInputString[ cInputIndex ] = cInChar;
						cInputIndex++;
					}
				}
			} //end of if( cInChar == '\n' ) else
		} //end of while( lByte < lBytes )
	} // end of for
}

 
int UartCommandSever_init(void)
{
    return 0;
}

int UartCommandSever_start(void)
{
	/* Create the task that handles the CLI on a UDP port.  The port number
	is set using the configUDP_CLI_PORT_NUMBER setting in FreeRTOSConfig.h. */
	xTaskCreate(    vUartCommandInterpreterTask,
	                "CLI",
	                configMINIMAL_STACK_SIZE,
	                NULL,
	                CLI_TASK_PRIORITY,
	                NULL );
    
    return 0;
}
